## sdkconfig.defaults
```kconfig
CONFIG_AUTOSTART_ARDUINO=n
# CONFIG_WS2812_LED_ENABLE is not set
CONFIG_FREERTOS_HZ=1000
CONFIG_MBEDTLS_PSK_MODES=y
CONFIG_MBEDTLS_KEY_EXCHANGE_PSK=y

#CONFIG_FREERTOS_USE_TRACE_FACILITY=y
#CONFIG_FREERTOS_USE_STATS_FORMATTING_FUNCTIONS=y
#CONFIG_FREERTOS_GENERATE_RUN_TIME_STATS=n 
CONFIG_ESP_TLS_INSECURE=y
CONFIG_ESP_TLS_SKIP_SERVER_CERT_VERIFY=y

CONFIG_HEAP_CORRUPTION_DETECTION=CONFIG_HEAP_POISONING_LIGHT
CONFIG_HEAP_POISONING_LIGHT=y

CONFIG_ESP32S3_SPIRAM_SUPPORT=y
CONFIG_SPIRAM_TRY_ALLOCATE_WIFI_LWIP=n
#CONFIG_BOOTLOADER_LOG_LEVEL=0
#CONFIG_LOG_BOOTLOADER_LEVEL_NONE=y
#CONFIG_BOOTLOADER_LOG_LEVEL_NONE=y
#CONFIG_ESP32S3_SPIRAM_SUPPORT=y
#CONFIG_LOG_DEFAULT_LEVEL_NONE=y
#CONFIG_LOG_DEFAULT_LEVEL=0
#CONFIG_LOG_MAXIMUM_LEVEL=0
#CONFIG_LOG_BOOTLOADER_LEVEL_NONE=y
#CONFIG_LOG_BOOTLOADER_LEVEL=0
#CONFIG_CXX_EXCEPTIONS=y
#CONFIG_COMPILER_CXX_EXCEPTIONS=y
#CONFIG_BOOTLOADER_WDT_ENABLE=n
#CONFIG_TASK_WDT=n

#Required for BTClock
CONFIG_SPIRAM_MODE_OCT=y
#CONFIG_SPIRAM_MODE_QUAD=n

# Save RAM
#CONFIG_LWIP_IPV4=y
#CONFIG_LWIP_IPV6=y
#CONFIG_ESP32_WIFI_STATIC_RX_BUFFER_NUM=6
#CONFIG_ESP32_WIFI_DYNAMIC_RX_BUFFER_NUM=12
#CONFIG_ESP_WIFI_DYNAMIC_TX_BUFFER_NUM=12
#CONFIG_ESP32_WIFI_RX_BA_WIN=6

CONFIG_FREERTOS_TIMER_TASK_STACK_DEPTH=3120
CONFIG_ESP_DEFAULT_CPU_FREQ_MHZ_240
CONFIG_ESP_DEFAULT_CPU_FREQ_MHZ_240=y
CONFIG_RTC_CLK_CAL_CYCLES=576
CONFIG_FREERTOS_WATCHPOINT_END_OF_STACK=y
CONFIG_FREERTOS_TIMER_TASK_STACK_DEPTH=3120
CONFIG_ESP_SYSTEM_MEMPROT_FEATURE=n
CONFIG_SPIRAM_CACHE_WORKAROUND=y
CONFIG_COMPILER_OPTIMIZATION_PERF=y 
CONFIG_COMPILER_OPTIMIZATION_LEVEL_RELEASE=y
```
